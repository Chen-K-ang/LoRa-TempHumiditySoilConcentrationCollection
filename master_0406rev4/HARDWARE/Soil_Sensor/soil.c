#include "soil.h"
#include "usart2.h"
#include "stdio.h"
#include "delay.h"
#include "usart.h"

//#define SOIL_DEBUG

SOIL_TypeDef SOIL_Sensor;


//CRC校验数据
const u8 auchCRCHi[] = { 
0x00, 0xC1, 0x81, 0x40, 0x01, 0xC0, 0x80, 0x41, 0x01, 0xC0,0x80, 0x41, 0x00, 0xC1, 0x81, 0x40, 0x01, 0xC0, 0x80, 0x41, 
0x00, 0xC1, 0x81, 0x40, 0x00, 0xC1, 0x81, 0x40, 0x01, 0xC0,0x80, 0x41, 0x01, 0xC0, 0x80, 0x41, 0x00, 0xC1, 0x81, 0x40, 
0x00, 0xC1, 0x81, 0x40, 0x01, 0xC0, 0x80, 0x41, 0x00, 0xC1,0x81, 0x40, 0x01, 0xC0, 0x80, 0x41, 0x01, 0xC0, 0x80, 0x41, 
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0x00, 0xC1, 0x81, 0x40, 0x01, 0xC0, 0x80, 0x41, 0x01, 0xC0,0x80, 0x41, 0x00, 0xC1, 0x81, 0x40} ; 


const u8 auchCRCLo[] = { 
0x00, 0xC0, 0xC1, 0x01, 0xC3, 0x03, 0x02, 0xC2, 0xC6, 0x06,0x07, 0xC7, 0x05, 0xC5, 0xC4, 0x04, 0xCC, 0x0C, 0x0D, 0xCD, 
0x0F, 0xCF, 0xCE, 0x0E, 0x0A, 0xCA, 0xCB, 0x0B, 0xC9, 0x09,0x08, 0xC8, 0xD8, 0x18, 0x19, 0xD9, 0x1B, 0xDB, 0xDA, 0x1A, 
0x1E, 0xDE, 0xDF, 0x1F, 0xDD, 0x1D, 0x1C, 0xDC, 0x14, 0xD4,0xD5, 0x15, 0xD7, 0x17, 0x16, 0xD6, 0xD2, 0x12, 0x13, 0xD3, 
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0x44, 0x84, 0x85, 0x45, 0x87, 0x47, 0x46, 0x86, 0x82, 0x42,0x43, 0x83, 0x41, 0x81, 0x80, 0x40} ;


u16 CRC_Compute(u8 *puchMsg, u16 usDataLen) 
{ 
	u8 uchCRCHi = 0xFF ; 
	u8 uchCRCLo = 0xFF ; 
	u32 uIndex ; 
	while (usDataLen--) 
	{ 
		uIndex = uchCRCHi ^ *puchMsg++ ; 
		uchCRCHi = uchCRCLo ^ auchCRCHi[uIndex] ; 
		uchCRCLo = auchCRCLo[uIndex] ; 
	} 
	return ((uchCRCHi<< 8)  | (uchCRCLo)) ; 
}


void Soil_Init(void)
{
	SOIL_Sensor.temp=0;
	SOIL_Sensor.humidity=0;
	SOIL_Sensor.ph_val=0;
	SOIL_Sensor.N_val=0;
	SOIL_Sensor.P_val=0;
	SOIL_Sensor.K_val=0;
}

void Soil_SendCommand(u8 SensorAddr,u8 Cmd,u16 StartAddr,u16 Len)
{
	u8 i=0;
	u8 Send_Buf[8];
	u8 num=0;
	u16 CRC_Check;
	Send_Buf[i++]=SensorAddr;		//传感器地址
	Send_Buf[i++]=Cmd;				//功能码
	Send_Buf[i++]=StartAddr>>8;		//起始地址
	Send_Buf[i++]=StartAddr&0X00FF;	
	Send_Buf[i++]=Len>>8;			//数据长度
	Send_Buf[i++]=Len&0X00FF;		
	/********************CRC校验**********************/
	CRC_Check = CRC_Compute(Send_Buf,i);
	Send_Buf[i++]=CRC_Check>>8;		//CRC校验数据
	Send_Buf[i++]=CRC_Check&0X00FF;	
	num=i;
	/********************串口发送数据*****************/
	USART2_RX_STA=0;//清除串口接收完成标志
	for(i=0;i<num;i++)
	{
		USART_SendData(USART2,Send_Buf[i]);
		while(USART_GetFlagStatus(USART2,USART_FLAG_TC) != SET);
	}
#ifdef SOIL_DEBUG
	//串口1打印数据
	UsartPrintf(USART_DEBUG,"USART2 Send:");
	for(i=0;i<num;i++)
	{
		UsartPrintf(USART_DEBUG,"%2x ",Send_Buf[i]);
	}
	UsartPrintf(USART_DEBUG,"\r\n");
#endif
}


void SOIL_RxTest(void)
{
#ifdef SOIL_DEBUG
	u16 len=0,j=0;
#endif
	if(USART2_RX_STA&0X8000)//接收完成一帧数据
	{
#ifdef SOIL_DEBUG
		UsartPrintf(USART_DEBUG,"串口二获完成一帧数据\r\n");
		len = USART2_RX_STA&0X3FFF;
		UsartPrintf(USART_DEBUG,"接收到的数据长度为:%d\r\n",len);
		UsartPrintf(USART_DEBUG,"接收到的数据为:\r\n");
		for(j=0;j<len;j++)
		{
			UsartPrintf(USART_DEBUG,"%2x ",USART2_RX_BUF[j]);
		}
		UsartPrintf(USART_DEBUG,"\r\n");
#endif
//		USART2_RX_STA=0;
	}
}



void Soil_ValAnalysis(SOIL_TypeDef *soil)
{
	u8 len=0;
	u16 CRC_Check = 0;
	int data = 0;
#ifdef SOIL_DEBUG
	SOIL_RxTest();
#endif
	if((USART2_RX_STA&0X8000)!=0)
	{
		len = USART2_RX_STA&0X3FFF;
		CRC_Check = CRC_Compute(USART2_RX_BUF,len-2);
#ifdef SOIL_DEBUG
		UsartPrintf(USART_DEBUG,"CRC_H:%2x CRC_L:%2x \r\n",CRC_Check>>8,CRC_Check&0X00FF);
#endif
		if(USART2_RX_BUF[len-1]==(CRC_Check&0X00FF))//验证CRC高位
		{
#ifdef SOIL_DEBUG
			UsartPrintf(USART_DEBUG,"CRC 高位验证成功\r\n");
#endif
			if(USART2_RX_BUF[len-2]==(CRC_Check>>8))//验证CRC高位
			{
#ifdef SOIL_DEBUG
				UsartPrintf(USART_DEBUG,"CRC 低位验证成功\r\n");
#endif
				data = (USART2_RX_BUF[3]<<8)+USART2_RX_BUF[4];
				soil->humidity = (float)data/10.0;
				data = (USART2_RX_BUF[5]<<8)+USART2_RX_BUF[6];
				soil->temp = (float)data/10.0;
				data = (USART2_RX_BUF[9]<<8)+USART2_RX_BUF[10];
				soil->ph_val = (float)data/10.0;
				
				data = (USART2_RX_BUF[11]<<8)+USART2_RX_BUF[12];
				soil->N_val = (float)data/10.0;
				data = (USART2_RX_BUF[13]<<8)+USART2_RX_BUF[14];
				soil->P_val = (float)data/10.0;
				data = (USART2_RX_BUF[15]<<8)+USART2_RX_BUF[16];
				soil->K_val = (float)data/10.0;
			}
			else
			{
#ifdef SOIL_DEBUG
				UsartPrintf(USART_DEBUG,"CRC 低位验证失败\r\n");
#endif	
			}
		}
		else
		{
#ifdef SOIL_DEBUG
			UsartPrintf(USART_DEBUG,"CRC 高位验证失败\r\n");
#endif	
		}
		USART2_RX_STA=0;
	}
}

void SOIL_GetOneData(SOIL_TypeDef *soil)
{
	while(1)//获取湿度数据
	{
		Soil_SendCommand(SOIL_SensorADDR,0X03,HUMIDITY_REG,1);
		delay_ms(5);
		if(USART2_RX_STA&0X8000)break;
	}
	USART2_RX_STA=0;
}





